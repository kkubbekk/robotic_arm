VERSION ""

NS_ :

BS_:

BU_:

BO_ 200 joint0: 8 Vector__XXX
 SG_ joint0_pos : 32|32@1+ (1,0) [0|0] "" Vector__XXX
 SG_ joint0_vel : 0|32@1+ (1,0) [0|0] "" Vector__XXX

BO_ 201 joint1: 8 Vector__XXX
 SG_ joint1_pos : 32|32@1+ (1,0) [0|0] "" Vector__XXX
 SG_ joint1_vel : 0|32@1+ (1,0) [0|0] "" Vector__XXX

BO_ 202 joint2: 8 Vector__XXX
 SG_ joint2_pos : 32|32@1+ (1,0) [0|0] "" Vector__XXX
 SG_ joint2_vel : 0|32@1+ (1,0) [0|0] "" Vector__XXX

BO_ 203 joint3: 8 Vector__XXX
 SG_ joint3_pos : 32|32@1+ (1,0) [0|0] "" Vector__XXX
 SG_ joint3_vel : 0|32@1+ (1,0) [0|0] "" Vector__XXX

BO_ 204 joint4: 8 Vector__XXX
 SG_ joint4_pos : 32|32@1+ (1,0) [0|0] "" Vector__XXX
 SG_ joint4_vel : 0|32@1+ (1,0) [0|0] "" Vector__XXX

BO_ 205 joint5: 8 Vector__XXX
 SG_ joint5_pos : 32|32@1+ (1,0) [0|0] "" Vector__XXX
 SG_ joint5_vel : 0|32@1+ (1,0) [0|0] "" Vector__XXX

BO_ 1 start_command: 1 Vector__XXX
 SG_ start_sig : 0|8@1+ (1,0) [0|0] "" Vector__XXX

SIG_VALTYPE_ 200 joint0_vel : 1;
SIG_VALTYPE_ 200 joint0_pos : 1;
SIG_VALTYPE_ 201 joint1_vel : 1;
SIG_VALTYPE_ 201 joint1_pos : 1;
SIG_VALTYPE_ 202 joint2_vel : 1;
SIG_VALTYPE_ 202 joint2_pos : 1;
SIG_VALTYPE_ 203 joint3_vel : 1;
SIG_VALTYPE_ 203 joint3_pos : 1;
SIG_VALTYPE_ 204 joint4_vel : 1;
SIG_VALTYPE_ 204 joint4_pos : 1;
SIG_VALTYPE_ 205 joint5_vel : 1;
SIG_VALTYPE_ 205 joint5_pos : 1;
