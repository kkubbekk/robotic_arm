VERSION ""

NS_ :

BS_:

BU_:

BO_ 200 joint1: 8 Vector__XXX
 SG_ joint1_pos : 32|32@1+ (1,0) [0|0] "" Vector__XXX
 SG_ joint1_vel : 0|32@1+ (1,0) [0|0] "" Vector__XXX

SIG_VALTYPE_ 200 joint1_vel : 1;
SIG_VALTYPE_ 200 joint1_pos : 1;
